## drivers/net/wireless/Kconfig
```kconfig
# SPDX-License-Identifier: GPL-2.0-only
#
# Wireless LAN device configuration
#

menuconfig WLAN
	bool "Wireless LAN"
	depends on !S390
	depends on NET
	select WIRELESS
	default y
	help
	  This section contains all the pre 802.11 and 802.11 wireless
	  device drivers. For a complete list of drivers and documentation
	  on them refer to the wireless wiki:

	  https://wireless.wiki.kernel.org/en/users/Drivers

if WLAN

# removed source "drivers/net/wireless/admtek/Kconfig"
# removed source "drivers/net/wireless/ath/Kconfig"
# removed source "drivers/net/wireless/atmel/Kconfig"
# removed source "drivers/net/wireless/broadcom/Kconfig"
source "drivers/net/wireless/intel/Kconfig"
# removed source "drivers/net/wireless/intersil/Kconfig"
# removed source "drivers/net/wireless/marvell/Kconfig"
source "drivers/net/wireless/mediatek/Kconfig"
# removed source "drivers/net/wireless/microchip/Kconfig"
# removed source "drivers/net/wireless/morsemicro/Kconfig"
# removed source "drivers/net/wireless/nxp/Kconfig"
# removed source "drivers/net/wireless/purelifi/Kconfig"
# removed source "drivers/net/wireless/ralink/Kconfig"
# removed source "drivers/net/wireless/realtek/Kconfig"
# removed source "drivers/net/wireless/rsi/Kconfig"
# removed source "drivers/net/wireless/silabs/Kconfig"
# removed source "drivers/net/wireless/st/Kconfig"
# removed source "drivers/net/wireless/ti/Kconfig"
# removed source "drivers/net/wireless/zydas/Kconfig"
# removed source "drivers/net/wireless/quantenna/Kconfig"

# removed source "drivers/net/wireless/virtual/Kconfig"

endif # WLAN
```

## drivers/platform/Kconfig
```kconfig
# SPDX-License-Identifier: GPL-2.0-only
# removed source "drivers/platform/mips/Kconfig"

# removed source "drivers/platform/loongarch/Kconfig"

# removed source "drivers/platform/goldfish/Kconfig"

# removed source "drivers/platform/chrome/Kconfig"

source "drivers/platform/cznic/Kconfig"

source "drivers/platform/mellanox/Kconfig"

source "drivers/platform/olpc/Kconfig"

source "drivers/platform/surface/Kconfig"

source "drivers/platform/x86/Kconfig"

source "drivers/platform/arm64/Kconfig"

source "drivers/platform/raspberrypi/Kconfig"

source "drivers/platform/wmi/Kconfig"
```

## fs/fuse/Kconfig
```kconfig
# SPDX-License-Identifier: GPL-2.0-only
config FUSE_FS
	tristate "FUSE (Filesystem in Userspace) support"
	select FS_POSIX_ACL
	select FS_IOMAP
	help
	  With FUSE it is possible to implement a fully functional filesystem
	  in a userspace program.

	  There's also a companion library: libfuse2.  This library is available
	  from the FUSE homepage:
	  <https://github.com/libfuse/>
	  although chances are your distribution already has that library
	  installed if you've installed the "fuse" package itself.

	  See <file:Documentation/filesystems/fuse/fuse.rst> for more information.
	  See <file:Documentation/Changes> for needed library/utility version.

	  If you want to develop a userspace FS, or if you want to use
	  a filesystem based on FUSE, answer Y or M.

config CUSE
	tristate "Character device in Userspace support"
	depends on FUSE_FS
	help
	  This FUSE extension allows character devices to be
	  implemented in userspace.

	  If you want to develop or use a userspace character device
	  based on CUSE, answer Y or M.

# removed config VIRTIO_FS
# removed config FUSE_VDAX
# removed config FUSE_DAX
config FUSE_PASSTHROUGH
	bool "FUSE passthrough operations support"
	default y
	depends on FUSE_FS
	select FS_STACK
	help
	  This allows bypassing FUSE server by mapping specific FUSE operations
	  to be performed directly on a backing file.

	  If you want to allow passthrough operations, answer Y.

config FUSE_IO_URING
	bool "FUSE communication over io-uring"
	default y
	depends on FUSE_FS
	depends on IO_URING
	help
	  This allows sending FUSE requests over the io-uring interface and
          also adds request core affinity.

	  If you want to allow fuse server/client communication through io-uring,
	  answer Y
```

## io_uring/Kconfig
```kconfig
# SPDX-License-Identifier: GPL-2.0-only
#
# io_uring configuration
#

# removed config IO_URING_ZCRX
config IO_URING_BPF
	def_bool y
	depends on BPF
	depends on NET

config IO_URING_BPF_OPS
	def_bool y
	depends on IO_URING
	depends on BPF_SYSCALL && BPF_JIT && DEBUG_INFO_BTF
```

## net/9p/Kconfig
```kconfig
# SPDX-License-Identifier: GPL-2.0-only
#
# 9P protocol configuration
#

menuconfig NET_9P
	tristate "Plan 9 Resource Sharing Support (9P2000)"
	select NETFS_SUPPORT
	help
	  If you say Y here, you will get experimental support for
	  Plan 9 resource sharing via the 9P2000 protocol.

	  See <http://v9fs.sf.net> for more information.

	  If unsure, say N.

if NET_9P

# removed config NET_9P_FD
config NET_9P_VIRTIO
	depends on VIRTIO
	tristate "9P Virtio Transport"
	help
	  This builds support for a transports between
	  guest partitions and a host partition.

# removed config NET_9P_VSOCK
# removed config NET_9P_XEN
# removed config NET_9P_USBG
# removed config NET_9P_RDMA
config NET_9P_DEBUG
	bool "Debug information"
	help
	  Say Y if you want the 9P subsystem to log debug information.

endif
```

## net/ipv6/Kconfig
```kconfig
# SPDX-License-Identifier: GPL-2.0-only
#
# IPv6 configuration
#

menuconfig IPV6
	bool "The IPv6 protocol"
	default y
	select CRYPTO_LIB_SHA1
	help
	  Support for IP version 6 (IPv6).

	  For general information about IPv6, see
	  <https://en.wikipedia.org/wiki/IPv6>.
	  For specific information about IPv6 under Linux, see
	  Documentation/networking/ipv6.rst and read the HOWTO at
	  <https://www.tldp.org/HOWTO/Linux+IPv6-HOWTO/>

if IPV6

config IPV6_ROUTER_PREF
	bool "IPv6: Router Preference (RFC 4191) support"
	help
	  Router Preference is an optional extension to the Router
	  Advertisement message which improves the ability of hosts
	  to pick an appropriate router, especially when the hosts
	  are placed in a multi-homed network.

	  If unsure, say N.

config IPV6_ROUTE_INFO
	bool "IPv6: Route Information (RFC 4191) support"
	depends on IPV6_ROUTER_PREF
	help
	  Support of Route Information.

	  If unsure, say N.

config IPV6_OPTIMISTIC_DAD
	bool "IPv6: Enable RFC 4429 Optimistic DAD"
	help
	  Support for optimistic Duplicate Address Detection. It allows for
	  autoconfigured addresses to be used more quickly.

	  If unsure, say N.

# removed config INET6_AH
# removed config INET6_ESP
# removed config INET6_ESP_OFFLOAD
# removed config INET6_ESPINTCP
# removed config INET6_IPCOMP
# removed config IPV6_MIP6
config IPV6_ILA
	tristate "IPv6: Identifier Locator Addressing (ILA)"
	depends on NETFILTER
	select DST_CACHE
	select LWTUNNEL
	help
	  Support for IPv6 Identifier Locator Addressing (ILA).

	  ILA is a mechanism to do network virtualization without
	  encapsulation. The basic concept of ILA is that we split an
	  IPv6 address into a 64 bit locator and 64 bit identifier. The
	  identifier is the identity of an entity in communication
	  ("who") and the locator expresses the location of the
	  entity ("where").

	  ILA can be configured using the "encap ila" option with
	  "ip -6 route" command. ILA is described in
	  https://tools.ietf.org/html/draft-herbert-nvo3-ila-00.

	  If unsure, say N.

# removed config INET6_XFRM_TUNNEL
# removed config INET6_TUNNEL
# removed config IPV6_VTI
# removed config IPV6_SIT
# removed config IPV6_SIT_6RD
# removed config IPV6_NDISC_NODETYPE
# removed config IPV6_TUNNEL
# removed config IPV6_GRE
# removed config IPV6_FOU
# removed config IPV6_FOU_TUNNEL
config IPV6_MULTIPLE_TABLES
	bool "IPv6: Multiple Routing Tables"
	select FIB_RULES
	help
	  Support multiple routing tables.

config IPV6_SUBTREES
	bool "IPv6: source address based routing"
	depends on IPV6_MULTIPLE_TABLES
	help
	  Enable routing by source address or prefix.

	  The destination address is still the primary routing key, so mixing
	  normal and source prefix specific routes in the same routing table
	  may sometimes lead to unintended routing behavior.  This can be
	  avoided by defining different routing tables for the normal and
	  source prefix specific routes.

	  If unsure, say N.

config IPV6_MROUTE
	bool "IPv6: multicast routing"
	depends on IPV6
	select IP_MROUTE_COMMON
	help
	  Support for IPv6 multicast forwarding.
	  If unsure, say N.

config IPV6_MROUTE_MULTIPLE_TABLES
	bool "IPv6: multicast policy routing"
	depends on IPV6_MROUTE
	select FIB_RULES
	help
	  Normally, a multicast router runs a userspace daemon and decides
	  what to do with a multicast packet based on the source and
	  destination addresses. If you say Y here, the multicast router
	  will also be able to take interfaces and packet marks into
	  account and run multiple instances of userspace daemons
	  simultaneously, each one handling a single table.

	  If unsure, say N.

config IPV6_PIMSM_V2
	bool "IPv6: PIM-SM version 2 support"
	depends on IPV6_MROUTE
	help
	  Support for IPv6 PIM multicast routing protocol PIM-SMv2.
	  If unsure, say N.

config IPV6_SEG6_LWTUNNEL
	bool "IPv6: Segment Routing Header encapsulation support"
	depends on IPV6
	select LWTUNNEL
	select DST_CACHE
	select IPV6_MULTIPLE_TABLES
	help
	  Support for encapsulation of packets within an outer IPv6
	  header and a Segment Routing Header using the lightweight
	  tunnels mechanism. Also enable support for advanced local
	  processing of SRv6 packets based on their active segment.

	  If unsure, say N.

config IPV6_SEG6_HMAC
	bool "IPv6: Segment Routing HMAC support"
	depends on IPV6
	select CRYPTO_LIB_SHA1
	select CRYPTO_LIB_SHA256
	select CRYPTO_LIB_UTILS
	help
	  Support for HMAC signature generation and verification
	  of SR-enabled packets.

	  If unsure, say N.

config IPV6_SEG6_BPF
	def_bool y
	depends on IPV6_SEG6_LWTUNNEL
	depends on IPV6 = y

config IPV6_RPL_LWTUNNEL
	bool "IPv6: RPL Source Routing Header support"
	depends on IPV6
	select LWTUNNEL
	select DST_CACHE
	help
	  Support for RFC6554 RPL Source Routing Header using the lightweight
	  tunnels mechanism.

	  If unsure, say N.

config IPV6_IOAM6_LWTUNNEL
	bool "IPv6: IOAM Pre-allocated Trace insertion support"
	depends on IPV6
	select LWTUNNEL
	select DST_CACHE
	help
	  Support for the insertion of IOAM Pre-allocated Trace
	  Header using the lightweight tunnels mechanism.

	  If unsure, say N.

endif # IPV6
```
