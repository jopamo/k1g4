## Kconfig
```kconfig
# SPDX-License-Identifier: GPL-2.0
#
mainmenu "k1g4/$(ARCH) $(KERNELVERSION) Kernel Configuration"

source "scripts/Kconfig.include"

source "init/Kconfig"

source "kernel/Kconfig.freezer"

source "fs/Kconfig.binfmt"

source "mm/Kconfig"

source "net/Kconfig"

source "drivers/Kconfig"

source "fs/Kconfig"

source "security/Kconfig"

source "crypto/Kconfig"

source "lib/Kconfig"

source "lib/Kconfig.debug"

# removed source "Documentation/Kconfig"

source "io_uring/Kconfig"
```

## drivers/firmware/coreboot/Kconfig
```kconfig
# SPDX-License-Identifier: GPL-2.0-only
menuconfig COREBOOT_FIRMWARE
	bool "coreboot firmware drivers"
	default GOOGLE_FIRMWARE
	default n
	help
	  These firmware drivers are used by devices running coreboot
	  firmware, including Chromebooks and some Google servers.
	  They include shared support for coreboot table entries and
	  drivers for CBMEM, framebuffer, firmware console and VPD records.
	  If in doubt, say "N".

if COREBOOT_FIRMWARE

# removed config GOOGLE_SMI
config COREBOOT_CBMEM
	tristate "CBMEM entries in sysfs"
	depends on COREBOOT_TABLE
	default GOOGLE_CBMEM
	help
	  CBMEM is a downwards-growing memory region created by the
	  Coreboot BIOS containing tagged data structures from the
	  BIOS.  These data structures expose things like the verified
	  boot firmware variables, flash layout, firmware event log,
	  and more.

	  This option enables the cbmem module, which causes the
	  kernel to search for Coreboot CBMEM entries, and expose the
	  memory for each entry in sysfs under
	  /sys/bus/coreboot/devices/cbmem-<id>.

config COREBOOT_TABLE
	tristate "Coreboot Table Access"
	depends on HAS_IOMEM && (ACPI || OF)
	default GOOGLE_COREBOOT_TABLE
	help
	  This option enables the coreboot_table module, which provides other
	  firmware modules access to the coreboot table. The coreboot table
	  pointer is accessed through the ACPI "GOOGCB00" object or the
	  device tree node /firmware/coreboot.
	  If unsure say N.

config COREBOOT_CFR
	tristate "coreboot CFR firmware attributes"
	depends on EFI
	depends on COREBOOT_TABLE
	depends on HAS_IOPORT
	select CRC32
	select FW_ATTR_CLASS
	help
	  This driver parses the coreboot CFR table and exposes runtime EFI
	  variable-backed options through the firmware-attributes sysfs
	  interface.

	  If you have a system running coreboot with CFR runtime
	  configuration support, say Y or M here.

config COREBOOT_MEMCONSOLE_COMMON
	tristate
	depends on COREBOOT_MEMCONSOLE
	default GOOGLE_MEMCONSOLE

# removed config GOOGLE_MEMCONSOLE_X86_LEGACY
config COREBOOT_FRAMEBUFFER
	tristate "Coreboot Framebuffer"
	depends on COREBOOT_TABLE
	default GOOGLE_FRAMEBUFFER_COREBOOT
	help
	  This option enables the kernel to search for a framebuffer in
	  the coreboot table.  If found, it is registered with a platform
	  device of type coreboot-framebuffer. Using the old device of
	  type simple-framebuffer is deprecated.

config COREBOOT_MEMCONSOLE
	tristate "Firmware Memory Console"
	depends on COREBOOT_TABLE
	select COREBOOT_MEMCONSOLE_COMMON
	default GOOGLE_MEMCONSOLE_COREBOOT
	help
	  This option enables the kernel to search for a firmware log in
	  the coreboot table.  If found, this log is exported to userland
	  in the file /sys/firmware/log.
	  This is the coreboot-table backed variant of the firmware memory
	  console driver.

# removed config GOOGLE_VPD
endif # COREBOOT_FIRMWARE

config GOOGLE_FIRMWARE
	bool
	transitional

config GOOGLE_CBMEM
	tristate
	transitional

config GOOGLE_COREBOOT_TABLE
	tristate
	transitional

config GOOGLE_MEMCONSOLE
	tristate
	transitional

config GOOGLE_FRAMEBUFFER_COREBOOT
	tristate
	transitional

config GOOGLE_MEMCONSOLE_COREBOOT
	tristate
	transitional
```

## drivers/hsi/clients/Kconfig
```kconfig
# SPDX-License-Identifier: GPL-2.0-only
#
# HSI clients configuration
#

comment "HSI clients"

# removed config NOKIA_MODEM
# removed config CMT_SPEECH
# removed config SSI_PROTOCOL
config HSI_CHAR
	tristate "HSI/SSI character driver"
	depends on HSI
	help
	  If you say Y here, you will enable the HSI/SSI character driver.
	  This driver provides a simple character device interface for
	  serial communication with the cellular modem over HSI/SSI bus.
```

## drivers/media/common/Kconfig
```kconfig
# SPDX-License-Identifier: GPL-2.0-only
# Used by common drivers, when they need to ask questions
config MEDIA_COMMON_OPTIONS
	bool

comment "common driver options"
	depends on MEDIA_COMMON_OPTIONS

config CYPRESS_FIRMWARE
	tristate
	depends on USB

# removed config TTPCI_EEPROM
config UVC_COMMON
	tristate

config VIDEO_CX2341X
	tristate

# removed config VIDEO_TVEEPROM
# removed source "drivers/media/common/b2c2/Kconfig"
source "drivers/media/common/saa7146/Kconfig"
# removed source "drivers/media/common/siano/Kconfig"
source "drivers/media/common/v4l2-tpg/Kconfig"
source "drivers/media/common/videobuf2/Kconfig"
```

## drivers/media/pci/saa7146/Kconfig
```kconfig
# SPDX-License-Identifier: GPL-2.0-only
config VIDEO_HEXIUM_GEMINI
	tristate "Hexium Gemini frame grabber"
	depends on PCI && VIDEO_DEV && I2C
	select VIDEO_SAA7146_VV
	help
	  This is a video4linux driver for the Hexium Gemini frame
	  grabber card by Hexium. Please note that the Gemini Dual
	  card is *not* fully supported.

	  To compile this driver as a module, choose M here: the
	  module will be called hexium_gemini.

config VIDEO_HEXIUM_ORION
	tristate "Hexium HV-PCI6 and Orion frame grabber"
	depends on PCI && VIDEO_DEV && I2C
	select VIDEO_SAA7146_VV
	help
	  This is a video4linux driver for the Hexium HV-PCI6 and
	  Orion frame grabber cards by Hexium.

	  To compile this driver as a module, choose M here: the
	  module will be called hexium_orion.

# removed config VIDEO_MXB
```

## drivers/media/spi/Kconfig
```kconfig
# SPDX-License-Identifier: GPL-2.0-only
if VIDEO_DEV && SPI

comment "SPI I2C drivers auto-selected by 'Autoselect ancillary drivers'"
	depends on MEDIA_HIDE_ANCILLARY_SUBDRV && SPI

menu "Media SPI Adapters"

# removed config CXD2880_SPI_DRV
config VIDEO_GS1662
	tristate "Gennum Serializers video"
	depends on SPI && VIDEO_DEV
	select MEDIA_CONTROLLER
	select VIDEO_V4L2_SUBDEV_API
	help
	  Enable the GS1662 driver which serializes video streams.

endmenu

endif
```

## drivers/media/test-drivers/Kconfig
```kconfig
# SPDX-License-Identifier: GPL-2.0-only

menuconfig V4L_TEST_DRIVERS
	bool "V4L test drivers"
	depends on VIDEO_DEV

if V4L_TEST_DRIVERS

config VIDEO_VIM2M
	tristate "Virtual Memory-to-Memory Driver"
	depends on VIDEO_DEV
	select VIDEOBUF2_VMALLOC
	select V4L2_MEM2MEM_DEV
	select MEDIA_CONTROLLER
	help
	  This is a virtual test device for the memory-to-memory driver
	  framework.

source "drivers/media/test-drivers/vicodec/Kconfig"
source "drivers/media/test-drivers/vimc/Kconfig"
source "drivers/media/test-drivers/vivid/Kconfig"
source "drivers/media/test-drivers/visl/Kconfig"

endif #V4L_TEST_DRIVERS

# removed config DVB_TEST_DRIVERS
if n

# removed source "drivers/media/test-drivers/vidtv/Kconfig"

endif #DVB_TEST_DRIVERS
```

## drivers/media/tuners/Kconfig
```kconfig
# SPDX-License-Identifier: GPL-2.0-only
# Analog TV tuners, auto-loaded via tuner.ko
# removed config MEDIA_TUNER
comment "Tuner drivers auto-selected by 'Autoselect ancillary drivers'"
	depends on MEDIA_HIDE_ANCILLARY_SUBDRV
	depends on MEDIA_RADIO_SUPPORT || MEDIA_SDR_SUPPORT

menu "Customize TV tuners"
	visible if !MEDIA_HIDE_ANCILLARY_SUBDRV
	depends on MEDIA_RADIO_SUPPORT || MEDIA_SDR_SUPPORT

# removed config MEDIA_TUNER_E4000
# removed config MEDIA_TUNER_FC0011
# removed config MEDIA_TUNER_FC0012
# removed config MEDIA_TUNER_FC0013
# removed config MEDIA_TUNER_FC2580
# removed config MEDIA_TUNER_IT913X
# removed config MEDIA_TUNER_M88RS6000T
# removed config MEDIA_TUNER_MAX2165
# removed config MEDIA_TUNER_MC44S803
config MEDIA_TUNER_MSI001
	tristate "Mirics MSi001"
	depends on MEDIA_SUPPORT && SPI && VIDEO_DEV
	default m if !MEDIA_SUBDRV_AUTOSELECT
	help
	  Mirics MSi001 silicon tuner driver.

# removed config MEDIA_TUNER_MT2060
# removed config MEDIA_TUNER_MT2063
# removed config MEDIA_TUNER_MT20XX
# removed config MEDIA_TUNER_MT2131
# removed config MEDIA_TUNER_MT2266
# removed config MEDIA_TUNER_MXL301RF
# removed config MEDIA_TUNER_MXL5005S
# removed config MEDIA_TUNER_MXL5007T
# removed config MEDIA_TUNER_QM1D1B0004
# removed config MEDIA_TUNER_QM1D1C0042
# removed config MEDIA_TUNER_QT1010
# removed config MEDIA_TUNER_R820T
# removed config MEDIA_TUNER_SI2157
# removed config MEDIA_TUNER_SIMPLE
# removed config MEDIA_TUNER_TDA18212
# removed config MEDIA_TUNER_TDA18218
# removed config MEDIA_TUNER_TDA18250
# removed config MEDIA_TUNER_TDA18271
# removed config MEDIA_TUNER_TDA827X
# removed config MEDIA_TUNER_TDA8290
# removed config MEDIA_TUNER_TDA9887
# removed config MEDIA_TUNER_TEA5761
# removed config MEDIA_TUNER_TEA5767
# removed config MEDIA_TUNER_TUA9001
# removed config MEDIA_TUNER_XC2028
# removed config MEDIA_TUNER_XC4000
# removed config MEDIA_TUNER_XC5000
endmenu
```

## drivers/net/ethernet/intel/Kconfig
```kconfig
# SPDX-License-Identifier: GPL-2.0-only
#
# Intel network device configuration
#

config NET_VENDOR_INTEL
	bool "Intel devices"
	default y
	help
	  If you have a network (Ethernet) card belonging to this class, say Y.

	  Note that the answer to this question doesn't directly affect the
	  kernel: saying N will just cause the configurator to skip all
	  the questions about Intel cards. If you say Y, you will be asked for
	  your specific card in the following questions.

if NET_VENDOR_INTEL

# removed source "drivers/net/ethernet/intel/libeth/Kconfig"
# removed source "drivers/net/ethernet/intel/libie/Kconfig"

config E100
	tristate "Intel(R) PRO/100+ support"
	depends on PCI
	select MII
	help
	  This driver supports Intel(R) PRO/100 family of adapters.
	  To verify that your adapter is supported, find the board ID number
	  on the adapter. Look for a label that has a barcode and a number
	  in the format 123456-001 (six digits hyphen three digits).

	  Use the above information and the Adapter & Driver ID Guide that
	  can be located at:

	  <http://support.intel.com>

	  to identify the adapter.

	  More specific information on configuring the driver is in
	  <file:Documentation/networking/device_drivers/ethernet/intel/e100.rst>.

	  To compile this driver as a module, choose M here. The module
	  will be called e100.

config E1000
	tristate "Intel(R) PRO/1000 Gigabit Ethernet support"
	depends on PCI && HAS_IOPORT
	help
	  This driver supports Intel(R) PRO/1000 gigabit ethernet family of
	  adapters.  For more information on how to identify your adapter, go
	  to the Adapter & Driver ID Guide that can be located at:

	  <http://support.intel.com>

	  More specific information on configuring the driver is in
	  <file:Documentation/networking/device_drivers/ethernet/intel/e1000.rst>.

	  To compile this driver as a module, choose M here. The module
	  will be called e1000.

config E1000E
	tristate "Intel(R) PRO/1000 PCI-Express Gigabit Ethernet support"
	depends on PCI && (!SPARC32 || BROKEN)
	depends on PTP_1588_CLOCK_OPTIONAL
	select CRC32
	help
	  This driver supports the PCI-Express Intel(R) PRO/1000 gigabit
	  ethernet family of adapters. For PCI or PCI-X e1000 adapters,
	  use the regular e1000 driver For more information on how to
	  identify your adapter, go to the Adapter & Driver ID Guide that
	  can be located at:

	  <http://support.intel.com>

	  More specific information on configuring the driver is in
	  <file:Documentation/networking/device_drivers/ethernet/intel/e1000e.rst>.

	  To compile this driver as a module, choose M here. The module
	  will be called e1000e.

config E1000E_HWTS
	bool "Support HW cross-timestamp on PCH devices"
	default y
	depends on E1000E && X86
	help
	 Say Y to enable hardware supported cross-timestamping on PCH
	 devices. The cross-timestamp is available through the PTP clock
	 driver precise cross-timestamp ioctl (PTP_SYS_OFFSET_PRECISE).

config IGB
	tristate "Intel(R) 82575/82576 PCI-Express Gigabit Ethernet support"
	depends on PCI
	depends on PTP_1588_CLOCK_OPTIONAL
	select I2C
	select I2C_ALGOBIT
	help
	  This driver supports Intel(R) 82575/82576 gigabit ethernet family of
	  adapters.  For more information on how to identify your adapter, go
	  to the Adapter & Driver ID Guide that can be located at:

	  <http://support.intel.com>

	  More specific information on configuring the driver is in
	  <file:Documentation/networking/device_drivers/ethernet/intel/igb.rst>.

	  To compile this driver as a module, choose M here. The module
	  will be called igb.

config IGB_HWMON
	bool "Intel(R) PCI-Express Gigabit adapters HWMON support"
	default y
	depends on IGB && HWMON && !(IGB=y && HWMON=m)
	help
	  Say Y if you want to expose thermal sensor data on Intel devices.

	  Some of our devices contain thermal sensors, both external and internal.
	  This data is available via the hwmon sysfs interface and exposes
	  the onboard sensors.

config IGB_DCA
	bool "Direct Cache Access (DCA) Support"
	default y
	depends on IGB && DCA && !(IGB=y && DCA=m)
	help
	  Say Y here if you want to use Direct Cache Access (DCA) in the
	  driver.  DCA is a method for warming the CPU cache before data
	  is used, with the intent of lessening the impact of cache misses.

config IGBVF
	tristate "Intel(R) 82576 Virtual Function Ethernet support"
	depends on PCI
	help
	  This driver supports Intel(R) 82576 virtual functions.  For more
	  information on how to identify your adapter, go to the Adapter &
	  Driver ID Guide that can be located at:

	  <http://support.intel.com>

	  More specific information on configuring the driver is in
	  <file:Documentation/networking/device_drivers/ethernet/intel/igbvf.rst>.

	  To compile this driver as a module, choose M here. The module
	  will be called igbvf.

# removed config IXGBE
# removed config IXGBE_HWMON
# removed config IXGBE_DCA
# removed config IXGBE_DCB
# removed config IXGBE_IPSEC
# removed config IXGBEVF
# removed config IXGBEVF_IPSEC
# removed config I40E
# removed config I40E_DCB
# removed config IAVF
# removed config I40EVF
# removed config ICE
# removed config ICE_HWMON
# removed config ICE_SWITCHDEV
# removed config ICE_HWTS
# removed config FM10K
# removed config IGC
# removed config IGC_LEDS
# removed source "drivers/net/ethernet/intel/idpf/Kconfig"

# removed source "drivers/net/ethernet/intel/ixd/Kconfig"

source "drivers/net/ethernet/intel/igcr/Kconfig"
endif # NET_VENDOR_INTEL
```

## drivers/net/ethernet/intel/igcr/Kconfig
```kconfig
# SPDX-License-Identifier: GPL-2.0
config IGCR
	tristate "Intel I225/I226 Ethernet support (igcr)"
	depends on PCI
	depends on PTP_1588_CLOCK_OPTIONAL
	depends on ETHTOOL_NETLINK
	help
	  Build the igcr driver for Intel I225/I226 Ethernet controllers.
	  The module is called igcr.

config IGCR_LEDS
	def_bool LEDS_TRIGGER_NETDEV
	depends on IGCR && LEDS_CLASS
	depends on LEDS_CLASS=y || IGCR=m
```

## drivers/net/ethernet/netronome/Kconfig
```kconfig
# SPDX-License-Identifier: GPL-2.0-only
#
# Netronome device configuration
#

config NET_VENDOR_NETRONOME
	bool "Netronome(R) devices"
	default y
	help
	  If you have a Netronome(R) network (Ethernet) card or device, say Y.

	  Note that the answer to this question doesn't directly affect the
	  kernel: saying N will just cause the configurator to skip all
	  the questions about Netronome(R) cards. If you say Y, you will be
	  asked for your specific card in the following questions.

if NET_VENDOR_NETRONOME

# removed config NFP
# removed config NFP_APP_FLOWER
# removed config NFP_APP_ABM_NIC
# removed config NFP_NET_IPSEC
# removed config NFP_DEBUG
endif
```
